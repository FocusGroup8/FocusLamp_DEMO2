// Generated by render_reminder.cpp --firmware-art.
constexpr int kEyeTop = 105, kEyeWidth = 140, kEyeHeight = 160;
constexpr int kEyeLefts[] = {81, 259};
constexpr uint16_t kEyeColours[] = {
    2276,4324,2244,4292,2243,2211,163,2212,130,131,2179,162,2210,2275,4325,4291,4356,4357,4293,195,4323,6405,6404,6436,
    6437,6373,129,98,97,6372,8485,2242,4259,6406,8486,8549,18952,25258,33580,35725,41967,44047,46128,44079,46160,44080,29419,6438,
    16840,23178,35661,39918,46161,48209,33612,12678,2178,8517,21033,39886,37774,6371,8518,21034,31500,48241,46192,46193,10630,16872,27338,48273,
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    27274,14694,12644,21031,23144,27305,29386,25193,16806,6370,
};
constexpr uint8_t kEyeIndices[] = {
    0,1,0,1,0,1,2,1,2,1,2,1,2,1,2,1,2,1,2,1,2,1,2,1,
    2,1,2,1,2,1,2,1,2,1,2,1,2,1,2,1,2,1,2,1,2,1,2,1,
    2,1,2,1,2,3,2,3,4,3,2,3,4,3,2,3,4,3,2,3,4,3,2,2,
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    160,177,160,177,160,177,160,177,160,177,160,177,160,177,160,177,
};
