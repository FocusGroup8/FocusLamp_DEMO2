## components/audio_bridge/Kconfig.projbuild
```kconfig
menu "Audio Bridge"
    config AUDIO_BRIDGE_ENABLE
        bool "Enable Audio Bridge"
        default y
        help
            Enable the Audio Bridge component for I2S audio playback and recording.

    config AUDIO_BRIDGE_DEFAULT_SAMPLE_RATE
        int "Default sample rate (Hz)"
        default 16000
        range 8000 48000
        depends on AUDIO_BRIDGE_ENABLE

    config AUDIO_BRIDGE_DEFAULT_VOLUME
        int "Default volume (%)"
        default 70
        range 0 100
        depends on AUDIO_BRIDGE_ENABLE

    config AUDIO_BRIDGE_DECODE_TASK_STACK_SIZE
        int "OPUS decode task stack size (bytes)"
        default 8192
        range 4096 32768
        depends on AUDIO_BRIDGE_ENABLE
        help
            Stack size for the dedicated OPUS audio decode task.
            Must be large enough for OPUS decoder stack usage plus
            FPU/PIE/HWLOOP coprocessor lazy save areas allocated
            from the task stack bottom by FreeRTOS.
            ESP32-P4 coprocessor save areas: FPU=136B, PIE=~200B, HWLOOP=~20B.
            8KB is sufficient for OPUS 16kHz mono 60ms decoding.

    config AUDIO_BRIDGE_DECODE_TASK_PRIORITY
        int "OPUS decode task priority"
        default 5
        range 1 25
        depends on AUDIO_BRIDGE_ENABLE
        help
            FreeRTOS priority for the OPUS audio decode task.
            Should be high enough to ensure smooth audio playback
            but not starve critical system tasks.

    config AUDIO_BRIDGE_DECODE_TASK_CORE
        int "OPUS decode task core ID"
        default -1
        range -1 1
        depends on AUDIO_BRIDGE_ENABLE
        help
            CPU core to pin the OPUS decode task to.
            -1: no affinity (task can run on any core)
            0: APP_CPU
            1: PRO_CPU
            Pinning to a specific core can improve audio stability
            by avoiding cache pollution from other tasks.
endmenu
```

## components/focuslamp_bridge/Kconfig.projbuild
```kconfig
menu "FocusLamp Bridge"

    config FOCUSLAMP_BRIDGE_ENABLE
        bool "Enable FocusLamp Bridge"
        default y
        help
            Enable the FocusLamp Bridge component for controlling FocusLamp_DEMO2
            device from wifi_test via HTTP REST API. When disabled, all API
            functions return ERR_NOT_SUPPORTED.

    config FOCUSLAMP_BRIDGE_TARGET_IP
        string "FocusLamp Device IP Address"
        default "0.0.0.0"
        depends on FOCUSLAMP_BRIDGE_ENABLE
        help
            IP address (with optional port) of the FocusLamp device.
            Example: "192.168.1.100" or "192.168.1.100:80".
            Set to "0.0.0.0" to disable HTTP requests (bridge init will warn).

endmenu
```

## components/heartbeat_service/Kconfig
```kconfig
menu "Heartbeat Service"

    config HEARTBEAT_SERVICE_ENABLE
        bool "Enable Heartbeat Service"
        default y
        help
            Enable the Heartbeat Service for WebSocket server client
            liveness detection via Ping/Pong frames.

    if HEARTBEAT_SERVICE_ENABLE

        config HEARTBEAT_SERVICE_PING_INTERVAL_SEC
            int "Ping interval (seconds)"
            default 30
            help
                Interval between Ping frames sent to connected clients.

        config HEARTBEAT_SERVICE_TIMEOUT_SEC
            int "Client timeout (seconds)"
            default 90
            help
                Time without Pong response before a client is considered dead.

    endif

endmenu
```

## components/mipi_dsi_bridge/Kconfig.projbuild
```kconfig
menu "MIPI-DSI Bridge"

    config MIPI_DSI_BRIDGE_ENABLE
        bool "Enable MIPI-DSI Bridge"
        default y
        help
            Enable the MIPI-DSI Bridge component for controlling mipi_dsi
            device from wifi_test via HTTP REST API. When disabled, all API
            functions return ERR_NOT_SUPPORTED.

    config MIPI_DSI_BRIDGE_TARGET_IP
        string "MIPI-DSI Device IP Address"
        default "0.0.0.0"
        depends on MIPI_DSI_BRIDGE_ENABLE
        help
            IP address (with optional port) of the mipi_dsi device.
            Example: "192.168.1.100" or "192.168.1.100:80".
            Set to "0.0.0.0" to disable HTTP requests (bridge init will warn).

endmenu
```

## components/modules/jpeg_encoder/Kconfig.projbuild
```kconfig
menu "JPEG Encoder Configuration"
    config PROJECT_ENABLE_JPEG_ENCODER
        bool "Enable JPEG Encoder"
        default n
        help
            Enable or disable the JPEG encoder component.
endmenu
```

## components/modules/lamp_head_controller/Kconfig.projbuild
```kconfig
menu "Lamp Head Controller Configuration"

    config LAMP_HEAD_TARGET_IP
        string "Lamp head board target IP address (with port)"
        default "10.10.42.209:80"
        help
            IP address and port of the lamp head (camera-fps) board's HTTP
            server, used for head LED and expression control.
            This is independent from the status reporter target (voice board).
            Example: "10.10.42.209:80"

endmenu
```

## components/modules/light_control_module/Kconfig.projbuild
```kconfig
menu "Light Control Module Configuration"

    config PROJECT_ENABLE_LIGHT_CONTROL
        bool "Enable Light Control Module"
        default n
        help
            Enable or disable the light control module.
            This module provides manual light control via the UART light
            controller. Automatic light adjustment based on the ambient light
            sensor was removed together with the light sensor module.

    config LIGHT_CONTROL_DEFAULT_BRIGHTNESS
        int "Default LED Brightness"
        default 200
        depends on PROJECT_ENABLE_LIGHT_CONTROL
        help
            Default brightness level for the LED when turned on (0-255).

    config LIGHT_CONTROL_DEFAULT_WARM
        int "Default Warm LED Brightness"
        default 0
        depends on PROJECT_ENABLE_LIGHT_CONTROL
        help
            Default brightness for warm LED (0-8191, 13-bit PWM).

    config LIGHT_CONTROL_DEFAULT_COLD
        int "Default Cold LED Brightness"
        default 0
        depends on PROJECT_ENABLE_LIGHT_CONTROL
        help
            Default brightness for cold LED (0-8191, 13-bit PWM).

    config LIGHT_CONTROL_DEFAULT_COLOR_R
        int "Default LED Color Red"
        default 200
        depends on PROJECT_ENABLE_LIGHT_CONTROL
        help
            Default red component of LED color (0-255).

    config LIGHT_CONTROL_DEFAULT_COLOR_G
        int "Default LED Color Green"
        default 100
        depends on PROJECT_ENABLE_LIGHT_CONTROL
        help
            Default green component of LED color (0-255).

    config LIGHT_CONTROL_DEFAULT_COLOR_B
        int "Default LED Color Blue"
        default 30
        depends on PROJECT_ENABLE_LIGHT_CONTROL
        help
            Default blue component of LED color (0-255).

endmenu
```

## components/modules/motion_controller/Kconfig.projbuild
```kconfig
menu "Motion Controller Configuration"

    config MOTION_CONTROLLER_ENABLE
        bool "Enable Motion Controller Module"
        default y
        help
            Enable the motion controller module for unified mechanical arm management.

    if MOTION_CONTROLLER_ENABLE

        menu "Home Position Configuration"

            config MOTION_HOME_EM3_POS
                int "EM3 Home Position"
                default 1500
                help
                    EM3 servo home position (0-3000).

            config MOTION_HOME_LX1_POS
                int "LX ID1 Home Position"
                default 500
                help
                    LX servo ID1 home position (0-1000).

            config MOTION_HOME_LX2_POS
                int "LX ID2 Home Position"
                default 550
                help
                    LX servo ID2 home position (0-1000).

            config MOTION_HOME_LX3_POS
                int "LX ID3 Home Position"
                default 700
                help
                    LX servo ID3 home position (0-1000).

            config MOTION_HOME_LX5_POS
                int "LX ID5 Home Position"
                default 420
                help
                    LX servo ID5 home position (0-1000).

            config MOTION_HOME_TIME_MS
                int "Homing Movement Time (ms)"
                default 1500
                help
                    Time for homing sequence movement in milliseconds.

        endmenu

        menu "Safety Limits Configuration"

            config MOTION_EM3_MIN_POS
                int "EM3 Minimum Position"
                default 0
                help
                    EM3 servo minimum position limit.

            config MOTION_EM3_MAX_POS
                int "EM3 Maximum Position"
                default 3000
                help
                    EM3 servo maximum position limit.

            config MOTION_EM3_MAX_SPEED
                int "EM3 Maximum Speed"
                default 2000
                help
                    EM3 servo maximum speed limit (steps/sec).

            config MOTION_LX_MIN_POS
                int "LX Minimum Position"
                default 0
                help
                    LX servo minimum position limit.

            config MOTION_LX_MAX_POS
                int "LX Maximum Position"
                default 1000
                help
                    LX servo maximum position limit.

            config MOTION_LX_MAX_SPEED
                int "LX Maximum Speed"
                default 1000
                help
                    LX servo maximum speed limit.

        endmenu

        menu "Mode Limits Configuration"

            config MOTION_FOCUS_AMPLITUDE_RATIO
                int "Focus Mode Amplitude Ratio (%)"
                default 30
                help
                    Amplitude ratio for focus mode (percentage of normal limits).
                    Lower values mean smaller movement range.

            config MOTION_FOCUS_SPEED_RATIO
                int "Focus Mode Speed Ratio (%)"
                default 50
                help
                    Speed ratio for focus mode (percentage of normal limits).
                    Lower values mean slower movements.

            config MOTION_COMPANY_AMPLITUDE_RATIO
                int "Company Mode Amplitude Ratio (%)"
                default 50
                help
                    Amplitude ratio for company mode.

            config MOTION_COMPANY_SPEED_RATIO
                int "Company Mode Speed Ratio (%)"
                default 70
                help
                    Speed ratio for company mode.

        endmenu

        menu "Task Configuration"

            config MOTION_TASK_STACK_SIZE
                int "Motion Task Stack Size"
                default 4096
                help
                    Stack size for motion controller tasks.

            config MOTION_TASK_PRIORITY
                int "Motion Task Priority"
                default 5
                help
                    Priority for motion controller tasks.

        endmenu

        config MOTION_LOG_ENABLE
            bool "Enable Motion Controller Logging"
            default y
            help
                Enable detailed logging for motion controller.

    endif

endmenu
```

## components/modules/rest_api/Kconfig.projbuild
```kconfig
menu "REST API"

    config REST_API_ENABLE
        bool "Enable REST API module"
        default y
        help
            Enable the REST API module for external HTTP REST control.
            Registers /api/ endpoints on the websocket_manager HTTP server.
            When disabled, all API functions return ERR_NOT_SUPPORTED.

endmenu
```

## components/modules/servo_control_module/Kconfig.projbuild
```kconfig
menu "Servo Control Configuration"

    config PROJECT_ENABLE_SERVO_CONTROL
        bool "Enable Servo Control Module"
        default n
        help
            Enable or disable the servo control module.

    config SERVO_CONTROL_MAX_SLOTS
        int "Maximum Recording Slots"
        default 10
        depends on PROJECT_ENABLE_SERVO_CONTROL
        help
            Maximum number of recording slots.

    config SERVO_CONTROL_MAX_FRAMES
        int "Maximum Frames Per Slot"
        default 1000
        depends on PROJECT_ENABLE_SERVO_CONTROL
        help
            Maximum number of frames per recording slot.

    config SERVO_CONTROL_SAMPLING_MS
        int "Sampling Interval (ms)"
        default 50
        depends on PROJECT_ENABLE_SERVO_CONTROL
        help
            Sampling interval in milliseconds.

    config SERVO_CONTROL_PLAYBACK_SPEED_MULTIPLIER
        int "Playback Speed Multiplier (x10)"
        default 10
        depends on PROJECT_ENABLE_SERVO_CONTROL
        help
            Playback speed multiplier (x10).
            Example: 5 means 0.5x speed (slow motion).
            Example: 10 means 1.0x speed (normal).
            Example: 40 means 4.0x speed (fast motion).

    config SERVO_CONTROL_EM3_ID
        int "EM3 Servo ID"
        default 4
        depends on PROJECT_ENABLE_SERVO_CONTROL
        help
            EM3 servo ID.

    config SERVO_CONTROL_LX_COUNT
        int "LX Servo Count"
        default 4
        depends on PROJECT_ENABLE_SERVO_CONTROL
        help
            Number of LX servos.

    config SERVO_CONTROL_EM3_DEFAULT_SPEED
        int "EM3 Default Speed (steps/sec)"
        default 1000
        depends on PROJECT_ENABLE_SERVO_CONTROL
        help
            EM3 servo default speed for first frame (steps/sec).
            Range: 50-3000, default: 1000 (about 14.6 RPM).
            50 steps/sec ≈ 0.732 RPM (very slow)
            1000 steps/sec ≈ 14.6 RPM (medium)
            3000 steps/sec ≈ 43.9 RPM (very fast)

    config SERVO_CONTROL_EM3_MIN_SPEED
        int "EM3 Minimum Speed (steps/sec)"
        default 50
        depends on PROJECT_ENABLE_SERVO_CONTROL
        help
            EM3 servo minimum speed limit (steps/sec).
            Range: 10-100, default: 50 (about 0.732 RPM).

    config SERVO_CONTROL_EM3_MAX_SPEED
        int "EM3 Maximum Speed (steps/sec)"
        default 3000
        depends on PROJECT_ENABLE_SERVO_CONTROL
        help
            EM3 servo maximum speed limit (steps/sec).
            Range: 1000-5000, default: 3000 (about 43.9 RPM).

    config SERVO_CONTROL_EM3_POSITION_THRESHOLD
        int "EM3 Position Change Threshold"
        default 1500
        depends on PROJECT_ENABLE_SERVO_CONTROL
        help
            EM3 servo position change threshold for multi-step movement.
            When position change exceeds this threshold, the servo will move in multiple steps
            to avoid reverse rotation near boundaries.
            Range: 500-2000, default: 1500 (about 180 degrees).

endmenu
```
