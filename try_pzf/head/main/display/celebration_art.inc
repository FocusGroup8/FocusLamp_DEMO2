// Generated by tools/face-review-20261105/celebration-preview/render_reference.cpp.
// Use the --firmware-art option to regenerate.

static constexpr uint32_t kLeftEyeRows[] = {
    0,357,705,1071,1419,1785,2136,2499,2856,3213,3564,3873,4239,4590,4956,5226,5577,5883,6207,6537,6876,7206,7548,7872,
    8166,8487,8820,9147,9453,9783,10062,10398,10674,10950,11259,11538,11847,12150,12468,12765,13080,13395,13710,14019,14331,14652,14964,15273,
    15594,15915,16215,16539,16845,17163,17454,17766,18075,18390,18696,19011,19329,19638,19956,20268,20583,20889,21201,21507,21822,22134,22458,22761,
    23067,23355,23646,23925,24210,24543,24858,25182,25506,25824,26139,26448,26766,27081,27384,27681,27984,28290,28611,28893,29211,29526,29850,30171,
    30486,30825,31158,31488,31824,32154,32490,32832,33183,33534,33885,34245,34608,34962,35316,35679,36039,36399,36765,37131,37497,37863,38229,38592,

};
static constexpr uint8_t kLeftEyeRuns[] = {
    1,37,25,1,38,33,1,37,25,1,37,33,1,37,25,1,38,33,1,37,25,1,37,33,
    1,37,25,1,37,33,1,37,25,1,37,33,1,37,25,1,37,33,1,37,25,1,37,33,
    1,37,25,1,37,33,1,37,25,1,37,33,1,37,25,1,37,33,1,37,25,1,37,33,
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    1,196,16,1,163,16,
};
static constexpr Art kLeftEye{88,46,122,120,kLeftEyeRows,kLeftEyeRuns};

static constexpr uint32_t kRightEyeRows[] = {
    0,327,693,1023,1389,1716,2070,2409,2736,3075,3423,3708,4074,4410,4770,5025,5379,5682,6021,6345,6666,6987,7311,7635,
    7926,8241,8571,8895,9186,9507,9804,10122,10398,10692,10980,11244,11553,11844,12156,12468,12786,13083,13407,13728,14037,14343,14658,14985,
    15300,15621,15927,16242,16545,16857,17172,17490,17793,18105,18417,18723,19038,19350,19677,20004,20325,20631,20955,21264,21588,21885,22197,22485,
    22788,23073,23385,23673,23988,24315,24657,24990,25329,25641,25971,26253,26568,26871,27180,27468,27777,28083,28398,28686,28998,29310,29613,29916,
    30234,30540,30867,31170,31494,31800,32118,32430,32751,33072,33405,33726,34050,34374,34707,35028,35346,35658,35985,36294,36603,36915,37227,37521,

};
static constexpr uint8_t kRightEyeRuns[] = {
    1,195,16,1,196,16,1,195,16,1,196,16,1,195,16,1,196,16,1,195,16,1,196,16,
    1,195,16,1,196,16,1,195,16,1,196,16,1,195,16,1,196,16,1,195,16,1,196,16,
    2,195,16,1,163,16,1,196,16,1,163,16,1,195,16,1,163,16,1,196,16,1,163,16,
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    1,130,8,1,98,8,1,130,8,1,98,8,1,130,8,1,98,8,1,130,8,19,98,8,

};
static constexpr Art kRightEye{266,46,122,120,kRightEyeRows,kRightEyeRuns};

static constexpr uint32_t kTrophyRows[] = {
    0,2,4,6,8,10,12,14,28,42,52,62,72,82,92,102,112,122,140,158,176,194,212,242,
    260,278,296,314,332,350,368,386,404,430,464,498,532,566,600,630,664,698,732,766,800,834,868,902,
    936,970,1004,1038,1072,1106,1140,1170,1204,1238,1272,1306,1340,1374,1408,1442,1476,1510,1544,1578,1612,1646,1680,1714,
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    3744,3750,3756,3762,3768,3782,3796,3806,3820,3830,3840,3850,3860,3870,3884,3902,3904,3906,3908,3910,
};
static constexpr uint8_t kTrophyRuns[] = {
    218,0,218,0,218,0,218,0,218,0,218,0,218,0,44,0,1,60,1,162,124,191,1,162,
    1,60,46,0,42,0,1,1,1,201,128,255,1,201,1,1,44,0,42,0,1,196,130,255,
    1,196,44,0,41,0,1,48,132,255,1,48,43,0,41,0,1,143,132,255,1,143,43,0,
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    1,141,1,233,88,248,1,233,1,141,1,5,63,0,218,0,218,0,218,0,218,0,218,0,

};
static constexpr Art kTrophy{132,202,218,188,kTrophyRows,kTrophyRuns};

