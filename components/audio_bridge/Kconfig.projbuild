## components/modules/servo_web_control_module/Kconfig.projbuild
```kconfig
menu "Servo Web Control Module"
    config PROJECT_ENABLE_SERVO_WEB_CONTROL
        bool "Enable Servo Web Control Module"
        default n
        help
            Enable servo web control module for device control via WebSocket/HTTP.

    if PROJECT_ENABLE_SERVO_WEB_CONTROL
        config SERVO_WEB_CONTROL_WS_PORT
            int "WebSocket Port"
            default 80
            help
                Port for the WebSocket server.

        config SERVO_WEB_CONTROL_WS_ENDPOINT
            string "WebSocket Endpoint"
            default "/ws"
            help
                Path for the WebSocket connection.

        config SERVO_WEB_CONTROL_ENABLE_SERIAL_BRIDGE
            bool "Enable Serial Bridge Control"
            default y
            help
                Allow controlling servos via serial commands (JSON format).

        config SERVO_WEB_CONTROL_TASK_STACK_SIZE
            int "Task Stack Size"
            default 4096
            help
                Stack size for web control tasks.

        config SERVO_WEB_CONTROL_TASK_PRIORITY
            int "Task Priority"
            range 1 10
            default 5
            help
                Priority for web control tasks.
    endif
endmenu
```

## components/modules/status_reporter/Kconfig.projbuild
```kconfig
menu "Status Reporter"

    config STATUS_REPORTER_ENABLE
        bool "Enable Status Reporter"
        default y
        help
            Enable the Status Reporter component for sending status/sensor
            data from FocusLamp_DEMO2 to wifi_test via HTTP POST.
            When disabled, all API functions return ERR_NOT_SUPPORTED.

    config STATUS_REPORTER_TARGET_IP
        string "wifi_test Device IP Address"
        default "0.0.0.0"
        depends on STATUS_REPORTER_ENABLE
        help
            IP address (with optional port) of the wifi_test device that
            will receive status reports.
            Example: "192.168.1.100" or "192.168.1.100:80".
            Set to "0.0.0.0" to disable reporting (init will warn).

endmenu
```

## components/modules/sys_monitor/Kconfig.projbuild
```kconfig
menu "System Monitor Configuration"
    config PROJECT_ENABLE_SYS_MONITOR
        bool "Enable System Monitor"
        default n
        select FREERTOS_USE_TRACE_FACILITY
        select FREERTOS_GENERATE_RUN_TIME_STATS
        help
            Enable system resource monitoring module.

            When enabled, provides:
            - Heap memory monitoring (internal/SPIRAM)
            - Task CPU usage statistics
            - Task stack high water mark
            - Console commands for on-demand queries
            - Low memory alert with configurable thresholds

            Note: Automatically enables FreeRTOS trace facility and
            run-time stats generation (required for task monitoring).

    menu "Memory Alert Configuration"
        depends on PROJECT_ENABLE_SYS_MONITOR

        config PROJECT_SYS_MONITOR_INTERNAL_HEAP_WARN_THRESHOLD
            int "Internal Heap Warning Threshold (bytes)"
            default 51200
            range 1024 524288
            help
                Internal heap free size warning threshold in bytes.
                When free internal heap falls below this value, a warning log is emitted.
                Default: 51200 (50KB)

        config PROJECT_SYS_MONITOR_INTERNAL_HEAP_ERROR_THRESHOLD
            int "Internal Heap Error Threshold (bytes)"
            default 20480
            range 512 262144
            help
                Internal heap free size error threshold in bytes.
                When free internal heap falls below this value, an error log is emitted.
                Default: 20480 (20KB)

        config PROJECT_SYS_MONITOR_PSRAM_HEAP_WARN_THRESHOLD
            int "PSRAM Heap Warning Threshold (bytes)"
            default 524288
            range 10240 8388608
            help
                PSRAM heap free size warning threshold in bytes.
                When free PSRAM heap falls below this value, a warning log is emitted.
                Default: 524288 (512KB)

        config PROJECT_SYS_MONITOR_PSRAM_HEAP_ERROR_THRESHOLD
            int "PSRAM Heap Error Threshold (bytes)"
            default 262144
            range 5120 4194304
            help
                PSRAM heap free size error threshold in bytes.
                When free PSRAM heap falls below this value, an error log is emitted.
                Default: 262144 (256KB)

        config PROJECT_SYS_MONITOR_ALERT_CHECK_INTERVAL_MS
            int "Alert Check Interval (ms)"
            default 5000
            range 1000 60000
            help
                Interval in milliseconds for memory alert checking.
                Default: 5000 (5 seconds)
    endmenu

    menu "Console Commands Configuration"
        depends on PROJECT_ENABLE_SYS_MONITOR

        config PROJECT_SYS_MONITOR_ENABLE_CONSOLE_COMMANDS
            bool "Enable Console Commands"
            default y
            help
                Enable system monitor console commands.

                Available commands:
                - sys_heap: Show heap memory info
                - sys_tasks: Show task runtime stats
                - sys_stack: Show task stack high water mark
                - sys_stats: Show all system stats
    endmenu
endmenu
```

## components/modules/tts_bridge/Kconfig.projbuild
```kconfig
menu "TTS Bridge Configuration"

    config TTS_BRIDGE_TARGET_IP
        string "TTS board target IP address (with port)"
        default "10.10.40.92:80"
        help
            IP address and port of the TTS board's HTTP server.
            Example: "10.10.40.92:80"

endmenu
```

## components/modules/wifi_manager/Kconfig.projbuild
```kconfig
menu "WiFi Manager Configuration"

    config WIFI_MANAGER_ENABLE
        bool "Enable WiFi Manager"
        default y
        help
            Enable the WiFi Manager component. When disabled, all API
            functions return ERR_NOT_SUPPORTED.

    config WIFI_MANAGER_SSID
        string "WiFi SSID"
        default "myssid"
        depends on WIFI_MANAGER_ENABLE
        help
            SSID (network name) of the access point to connect to.

    config WIFI_MANAGER_PASSWORD
        string "WiFi Password"
        default "mypassword"
        depends on WIFI_MANAGER_ENABLE
        help
            WiFi password (WPA2 or WPA3) for the access point.

    config WIFI_MANAGER_MAX_RETRY
        int "Maximum retry count"
        default 5
        depends on WIFI_MANAGER_ENABLE
        help
            Maximum number of retries to connect to the AP before giving up.

    config WIFI_MANAGER_AUTO_RECONNECT
        bool "Enable auto-reconnect"
        default y
        depends on WIFI_MANAGER_ENABLE
        help
            Automatically reconnect to AP when disconnected.

endmenu
```

## components/touch_interpreter/Kconfig.projbuild
```kconfig
menu "Touch Interpreter"

    config TOUCH_INTERPRETER_ENABLE
        bool "Enable Touch Interpreter (gesture recognition)"
        default n
        depends on TOUCH_SENSOR_ENABLE
        help
            Enable touch gesture recognition engine.
            Consumes raw events from touch_sensor and recognizes:
            TAP, DOUBLE_TAP, LONG_PRESS.
            When disabled, all API functions return ESP_ERR_NOT_SUPPORTED.

    config TOUCH_INTERPRETER_TAP_MIN_MS
        int "Minimum tap duration (ms)"
        default 50
        range 30 500
        depends on TOUCH_INTERPRETER_ENABLE
        help
            Minimum touch duration to be recognized as a TAP.
            Touches shorter than this are filtered as noise.
            Calibrated from TTP223 field data: quick taps of 53-66ms
            must still be recognized (TAP_MIN below the fastest observed tap).

    config TOUCH_INTERPRETER_TAP_MAX_MS
        int "Maximum tap duration (ms)"
        default 500
        range 100 2000
        depends on TOUCH_INTERPRETER_ENABLE
        help
            Maximum touch duration to be recognized as a TAP.
            Touches longer than this are either LONG_PRESS or ignored.
            500ms accommodates the slow release of the TTP223 sensor;
            durations between TAP_MAX and LONG_PRESS are discarded.

    config TOUCH_INTERPRETER_DOUBLE_TAP_MIN_MS
        int "Minimum double-tap interval (ms)"
        default 50
        range 20 1000
        depends on TOUCH_INTERPRETER_ENABLE
        help
            Minimum interval between two taps for DOUBLE_TAP recognition.
            Lower values make double-tap easier to trigger.
            50ms is recommended for TTP223 sensors with ~60ms response time.

    config TOUCH_INTERPRETER_DOUBLE_TAP_MAX_MS
        int "Maximum double-tap interval (ms)"
        default 700
        range 100 2000
        depends on TOUCH_INTERPRETER_ENABLE
        help
            Maximum interval between two taps for DOUBLE_TAP recognition.
            If the second tap arrives later than this, the first tap
            is reported as a single TAP instead.

    config TOUCH_INTERPRETER_LONG_PRESS_MS
        int "Long press threshold (ms)"
        default 700
        range 500 10000
        depends on TOUCH_INTERPRETER_ENABLE
        help
            Duration threshold for LONG_PRESS recognition.
            Touch held continuously for longer than this triggers LONG_PRESS.
            Calibrated from TTP223 field data: user long presses measured
            853-1040ms, so 700ms reliably triggers while still separating
            from TAP_MAX (500ms).

    config TOUCH_INTERPRETER_VALID_TOUCH_MIN_MS
        int "Minimum valid touch duration (ms)"
        default 50
        range 10 500
        depends on TOUCH_INTERPRETER_ENABLE
        help
            Minimum duration for a touch to be considered valid.
            Touches shorter than this are filtered as noise/glitch.

    config TOUCH_INTERPRETER_VALID_TOUCH_MAX_MS
        int "Maximum valid touch duration (ms)"
        default 300
        range 100 5000
        depends on TOUCH_INTERPRETER_ENABLE
        help
            Maximum duration for a single tap to be considered valid.
            Only used as an upper bound for TAP classification.

    config TOUCH_INTERPRETER_DEBUG_LOG
        bool "Log raw PRESS/RELEASE touch timing (threshold calibration)"
        default y
        depends on TOUCH_INTERPRETER_ENABLE
        help
            Print every PRESS/RELEASE event with its duration and the gap
            between consecutive presses. Use these measurements to pick the
            TAP / DOUBLE_TAP / LONG_PRESS thresholds in this menu.
            Disable after calibration to reduce log output.

endmenu
```

## components/touch_sensor/Kconfig.projbuild
```kconfig
menu "Touch Sensor"

    config TOUCH_SENSOR_ENABLE
        bool "Enable Touch Sensor (TTP223)"
        default n
        help
            Enable TTP223 capacitive touch sensor driver.
            Reads digital output from TTP223 via GPIO interrupt.
            When disabled, all API functions return ESP_ERR_NOT_SUPPORTED.

    config TOUCH_SENSOR_GPIO
        int "TTP223 OUT GPIO pin"
        default 21
        range 0 54
        depends on TOUCH_SENSOR_ENABLE
        help
            GPIO pin connected to TTP223 OUT pin.
            TTP223 sync mode: HIGH = touch detected, LOW = released.

    config TOUCH_SENSOR_DEBOUNCE_MS
        int "Software debounce time (ms)"
        default 50
        range 10 200
        depends on TOUCH_SENSOR_ENABLE
        help
            Minimum time between consecutive GPIO interrupt processing.
            TTP223 has built-in hardware debounce; this adds software-level
            filtering for additional noise rejection.
            Lower values = faster response, higher values = more filtering.

    config TOUCH_SENSOR_MIN_INTERVAL_MS
        int "Minimum touch event interval (ms)"
        default 100
        range 50 500
        depends on TOUCH_SENSOR_ENABLE
        help
            DEPRECATED: no longer filters press<->release direction changes
            (a quick tap would otherwise lose its RELEASE edge and be misread
            as LONG_PRESS). Kept only for sdkconfig compatibility.
            Debounce now applies to same-direction bounce edges only.

endmenu
```

## components/websocket_manager/Kconfig.projbuild
```kconfig
menu "WebSocket Manager Configuration"

    config WS_MANAGER_ENABLE
        bool "Enable WebSocket Manager"
        default y
        help
            Enable the WebSocket Manager component. When disabled, all API
            functions return ERR_NOT_SUPPORTED.

    menu "Client Configuration"
        depends on WS_MANAGER_ENABLE

        config WS_MANAGER_CLIENT_ENABLE
            bool "Enable WebSocket Client"
            default y
            help
                Enable WebSocket client functionality.

        config WS_MANAGER_PING_INTERVAL
            int "Ping interval (seconds)"
            default 10
            depends on WS_MANAGER_CLIENT_ENABLE
            help
                WebSocket Ping/Pong keep-alive interval in seconds.

        config WS_MANAGER_RECONNECT_TIMEOUT_MS
            int "Reconnect timeout (milliseconds)"
            default 10000
            depends on WS_MANAGER_CLIENT_ENABLE
            help
                Time to wait before reconnecting after disconnection.
                The actual reconnect uses exponential backoff starting from this value.

        config WS_MANAGER_BUFFER_SIZE
            int "WebSocket buffer size (bytes)"
            default 1024
            depends on WS_MANAGER_CLIENT_ENABLE
            help
                Size of the WebSocket send/receive buffer.

    endmenu

    menu "Server Configuration"
        depends on WS_MANAGER_ENABLE

        config WS_MANAGER_SERVER_ENABLE
            bool "Enable WebSocket Server"
            default y
            select HTTPD_WS_SUPPORT
            help
                Enable WebSocket server functionality based on esp_http_server.

        config WS_MANAGER_SERVER_PORT
            int "Server port"
            default 80
            depends on WS_MANAGER_SERVER_ENABLE
            help
                HTTP/WebSocket server listen port.

        config WS_MANAGER_SERVER_MAX_CONN
            int "Maximum concurrent connections"
            default 4
            depends on WS_MANAGER_SERVER_ENABLE
            help
                Maximum number of simultaneous WebSocket client connections.

    endmenu

    menu "TLS Configuration"
        depends on WS_MANAGER_ENABLE

        config WS_MANAGER_TLS_ENABLE
            bool "Enable TLS support (wss://)"
            default n
            help
                Enable WebSocket over TLS. When enabled, the client can connect
                to wss:// URIs. Server TLS support requires certificate configuration.

    endmenu

endmenu
```
