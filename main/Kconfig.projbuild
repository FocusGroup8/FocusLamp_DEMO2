## main/Kconfig.projbuild
```kconfig
# ============================================================
# FocusLamp - Application Configuration (Z0.5 Refactored)
# ============================================================

menu "Display Configuration"

    menu "LCD Driver"
        config PROJECT_LCD_DRIVER_ENABLE
            bool "Enable LCD Display"
            default n
            help
                Enable LCD display module. If enabled, LCD display task will be started.

        choice PROJECT_LCD_UI_MODE
            prompt "UI Mode"
            default PROJECT_LCD_UI_NATIVE
            depends on PROJECT_LCD_DRIVER_ENABLE
            help
                - Native: Use lcd_module with custom drawing.
                - LVGL: Use LVGL graphics library for rich UI.

            config PROJECT_LCD_UI_NATIVE
                bool "Native LCD Module"
            config PROJECT_LCD_UI_LVGL
                bool "LVGL UI"
        endchoice

        menu "Hardware Pins"
            depends on PROJECT_LCD_DRIVER_ENABLE
            config PROJECT_LCD_SPI_HOST
                int "SPI Host"
                default 1
                range 1 2
                help
                    1=SPI2_HOST, 2=SPI3_HOST.

            config PROJECT_LCD_SPI_CLOCK_SPEED
                int "SPI Clock (MHz)"
                default 10
                range 1 80

            config PROJECT_LCD_SPI_MOSI_GPIO
                int "MOSI GPIO (LCD_SDA)"
                default 38
                range 0 63

            config PROJECT_LCD_SPI_SCLK_GPIO
                int "SCLK GPIO (LCD_SCL)"
                default 50
                range 0 63

            config PROJECT_LCD_SPI_CS_GPIO
                int "CS GPIO"
                default 34
                range 0 63

            config PROJECT_LCD_SPI_DC_GPIO
                int "DC GPIO"
                default 49
                range 0 63

            config PROJECT_LCD_BL_GPIO
                int "Backlight GPIO"
                default 51
                range 0 63
        endmenu

        menu "Display Parameters"
            depends on PROJECT_LCD_DRIVER_ENABLE
            config PROJECT_LCD_WIDTH
                int "Width (pixels)"
                default 160

            config PROJECT_LCD_HEIGHT
                int "Height (pixels)"
                default 60

            config PROJECT_LCD_REFRESH_RATE
                int "Refresh Rate (Hz)"
                default 30
                range 1 60

            config PROJECT_LCD_DEFAULT_BRIGHTNESS
                int "Default Brightness (%)"
                default 80
                range 0 100

            config PROJECT_LCD_PWM_FREQUENCY
                int "PWM Frequency (Hz)"
                default 5000
                range 1000 20000
        endmenu

        menu "LCD Task (Native UI only)"
            depends on PROJECT_LCD_DRIVER_ENABLE && PROJECT_LCD_UI_NATIVE
            config PROJECT_LCD_TASK_STACK_SIZE
                int "Stack Size (bytes)"
                default 4096
                range 2048 8192

            config PROJECT_LCD_TASK_PRIORITY
                int "Priority"
                default 5
                range 1 10
        endmenu
    endmenu

    menu "LCD Module Features"
        depends on PROJECT_LCD_DRIVER_ENABLE
        config PROJECT_LCD_MODULE_ENABLE_EMOTION
            bool "Emotion Display"
            default y

        config PROJECT_LCD_MODULE_ENABLE_INFO
            bool "Info Display"
            default y
    endmenu

endmenu

# ============================================================
# Radar Configuration (HLK-LD6002)
# ============================================================
menu "Radar Configuration"

    config PROJECT_RADAR_DRIVER_ENABLE
        bool "Enable Radar UART Driver"
        default y
        help
            Enable the radar UART driver (HLK-LD6002).
            Uses a dedicated UART port (default UART3) that does NOT
            conflict with the servo buses (UART1=EM3, UART2=LX).
            When disabled, radar_driver_init() is a no-op.

    menu "Radar UART Pins"
        depends on PROJECT_RADAR_DRIVER_ENABLE

        config PROJECT_RADAR_UART_PORT
            int "UART Port"
            default 3
            range 0 3
            help
                UART port for the radar module. Default 3.
                UART1 is used by EM3 servo, UART2 by LX servo.
                Do NOT use 1 or 2 or the radar will conflict with servos.

        config PROJECT_RADAR_UART_BAUD_RATE
            int "Baud Rate"
            default 115200
            range 9600 921600
            help
                HLK-LD6002 protocol V1.3 defaults to 115200.

        config PROJECT_RADAR_UART_TX_GPIO
            int "TX GPIO (ESP32 TX -> radar RX)"
            default 7
            range 0 63

        config PROJECT_RADAR_UART_RX_GPIO
            int "RX GPIO (radar TX -> ESP32 RX)"
            default 1
            range 0 63
    endmenu

    config PROJECT_RADAR_LD6002_ENABLE
        bool "Enable HLK-LD6002 Radar Reader Task"
        default y
        depends on PROJECT_RADAR_DRIVER_ENABLE
        help
            Start the self-contained HLK-LD6002 radar reader task at
            boot. This module is independent from the existing
            radar_module / radar_frame_handler / event_bus pipeline
            and does not affect other features. Console command
            'radar_ld6002' can stop/restart it at runtime.

    menu "Demo"
        config PROJECT_DEMO_FAKE_DETECTION_ENABLE
            bool "Enable demo fake detection (play phone / sedentary timers)"
            default n
            help
                Start the demo fake phone/computer and sedentary detection
                timers at boot for demonstration without the real VLM
                pipeline. Disabled by default so the fake broadcasts do not
                interfere with the real algorithm-driven reminders.
    endmenu

endmenu
```

## try_pzf/controller/components/device_controller/Kconfig.projbuild
```kconfig
menu "Device Controller"

    config DEVICE_CONTROLLER_ENABLE
        bool "Enable Device Controller"
        default y
        help
            Enable the Device Controller component for simulated device control
            (lights, robotic arm, speaker). When disabled, all API functions
            return ERR_NOT_SUPPORTED.

endmenu
```

## try_pzf/controller/components/focuslamp_discovery/Kconfig.projbuild
```kconfig
menu "FocusLamp Discovery"

config FOCUSLAMP_DISCOVERY_ENABLE
    bool "Enable UDP peer discovery"
    default y

config FOCUSLAMP_KIT_ID
    string "Kit identifier (identical on controller and head)"
    default "focuslamp-dev-01"

config FOCUSLAMP_DISCOVERY_UDP_PORT
    int "Beacon UDP port"
    range 1 65535
    default 44444

config FOCUSLAMP_DISCOVERY_FAST_MS
    int "Initial beacon interval (ms)"
    range 1 60000
    default 3000

config FOCUSLAMP_DISCOVERY_FAST_WINDOW_MS
    int "Initial beacon window (ms)"
    range 1 600000
    default 30000

config FOCUSLAMP_DISCOVERY_SLOW_MS
    int "Steady beacon interval (ms)"
    range 1 600000
    default 10000

config FOCUSLAMP_DISCOVERY_PEER_TTL_MS
    int "Peer lifetime without a beacon (ms)"
    range 1 600000
    default 30000

endmenu
```

## try_pzf/controller/components/radar_driver/Kconfig.projbuild
```kconfig
menu "Local base radar (HLK-LD6002)"
    config PROJECT_RADAR_DRIVER_ENABLE
        bool "Enable local LD6002 UART reader"
        default y
    if PROJECT_RADAR_DRIVER_ENABLE
        config PROJECT_RADAR_UART_PORT
            int "Radar UART (dedicated UART3)"
            range 3 3
            default 3
        config PROJECT_RADAR_UART_BAUD_RATE
            int "Radar baud rate"
            range 9600 921600
            default 115200
        config PROJECT_RADAR_UART_TX_GPIO
            int "ESP TX -> radar RX"
            range 0 54
            default 7
        config PROJECT_RADAR_UART_RX_GPIO
            int "Radar TX -> ESP RX"
            range 0 54
            default 1
    endif
endmenu
```

## try_pzf/controller/components/status_receiver/Kconfig.projbuild
```kconfig
menu "Status Receiver"

    config STATUS_RECEIVER_ENABLE
        bool "Enable Status Receiver"
        default y
        help
            Enable the Status Receiver component for accepting status/sensor
            data reports from FocusLamp_DEMO2 via HTTP POST. When disabled,
            all API functions return ERR_NOT_SUPPORTED.

endmenu
```

## try_pzf/controller/components/task_guide/Kconfig.projbuild
```kconfig
menu "Three-step task guide"
    config TASK_GUIDE_WAIT_TIMEOUT_MS
        int "Wait for a complete task guide (milliseconds)"
        range 5000 120000
        default 30000
        help
            A timeout only means no complete result was received in time.
            Head owns all three 3-minute timers after the preview is delivered.
endmenu
```

## try_pzf/controller/components/task_manager/Kconfig.projbuild
```kconfig
menu "Task Manager"

    config TASK_MANAGER_ENABLE
        bool "Enable Task Manager"
        default y
        help
            Enable the Task Manager component for task scheduling and tracking.
            When disabled, all API functions return ESP_ERR_NOT_SUPPORTED.

    config TASK_MANAGER_MAX_TASKS
        int "Maximum concurrent tasks"
        default 4
        range 1 8
        depends on TASK_MANAGER_ENABLE
        help
            Maximum number of tasks that can be managed simultaneously.
            Each task uses a FreeRTOS timer and a small amount of RAM.

endmenu
```

## try_pzf/controller/components/touch_service/Kconfig.projbuild
```kconfig
menu "Local base touch"
    config LOCAL_TOUCH_ENABLE
        bool "Enable four TTP touch inputs (GPIO9/22/10/23)"
        default y
        help
            Recognize single/double/long/release events. Does not invoke
            power shutdown, LCD, or application-mode switching.
endmenu
```

## try_pzf/controller/components/wake_word_engine/Kconfig.projbuild
```kconfig
menu "Wake Word Engine"

    config WAKE_WORD_ENGINE_ENABLE
        bool "Enable Wake Word Engine"
        default y
        help
            Enable the Wake Word Engine component for ESP-SR MultiNet based
            custom wake word detection. When disabled, all API functions
            return ERR_NOT_SUPPORTED.

    choice WAKE_WORD_ENGINE_AFE_MODE
        prompt "AFE mode"
        default WAKE_WORD_ENGINE_AFE_MODE_HIGH_PERF
        depends on WAKE_WORD_ENGINE_ENABLE
        help
            AFE (Audio Front-End) processing mode.
            High performance provides better noise suppression.

        config WAKE_WORD_ENGINE_AFE_MODE_LOW_COST
            bool "Low cost"

        config WAKE_WORD_ENGINE_AFE_MODE_HIGH_PERF
            bool "High performance"
    endchoice

    config WAKE_WORD_ENGINE_AFE_MODE
        int
        default 0 if WAKE_WORD_ENGINE_AFE_MODE_LOW_COST
        default 1 if WAKE_WORD_ENGINE_AFE_MODE_HIGH_PERF

    choice WAKE_WORD_ENGINE_AFE_TYPE
        prompt "AFE type"
        default WAKE_WORD_ENGINE_AFE_TYPE_SR
        depends on WAKE_WORD_ENGINE_ENABLE
        help
            AFE type selection.
            SR mode is for speech recognition (includes linear NS).
            FD mode is for full duplex (includes nonlinear NS).

        config WAKE_WORD_ENGINE_AFE_TYPE_SR
            bool "Speech Recognition (SR)"

        config WAKE_WORD_ENGINE_AFE_TYPE_FD
            bool "Full Duplex (FD)"
    endchoice

    config WAKE_WORD_ENGINE_AFE_TYPE
        int
        default 0 if WAKE_WORD_ENGINE_AFE_TYPE_SR
        default 3 if WAKE_WORD_ENGINE_AFE_TYPE_FD

    choice WAKE_WORD_ENGINE_DEFAULT_LANG
        prompt "Default language"
        default WAKE_WORD_ENGINE_DEFAULT_LANG_CN
        depends on WAKE_WORD_ENGINE_ENABLE
        help
            Default language for MultiNet model.

        config WAKE_WORD_ENGINE_DEFAULT_LANG_CN
            bool "Chinese (mn7_cn)"

        config WAKE_WORD_ENGINE_DEFAULT_LANG_EN
            bool "English (mn7_en)"
    endchoice

    config WAKE_WORD_ENGINE_DEFAULT_LANG
        int
        default 0 if WAKE_WORD_ENGINE_DEFAULT_LANG_CN
        default 1 if WAKE_WORD_ENGINE_DEFAULT_LANG_EN

    config WAKE_WORD_ENGINE_TASK_STACK
        int "Detection task stack size"
        default 8192
        range 4096 32768
        depends on WAKE_WORD_ENGINE_ENABLE
        help
            Stack size for the wake word detection task.

    config WAKE_WORD_ENGINE_TASK_PRIORITY
        int "Detection task priority"
        default 5
        range 1 20
        depends on WAKE_WORD_ENGINE_ENABLE
        help
            FreeRTOS task priority for the wake word detection task.

    config WAKE_WORD_ENGINE_TASK_CORE
        int "Detection task CPU core"
        default 0
        range -1 1
        depends on WAKE_WORD_ENGINE_ENABLE
        help
            CPU core affinity for the detection task.
            -1 = no affinity, 0 = core 0, 1 = core 1.

    config WAKE_WORD_ENGINE_DET_THRESHOLD
        int "Detection threshold (x10000)"
        default 5000
        range 0 9999
        depends on WAKE_WORD_ENGINE_ENABLE
        help
            MultiNet detection threshold multiplied by 10000.
            E.g., 5000 means threshold=0.5. Higher values reduce false positives
            but may miss detections. Range: 0~9999 (0.0~0.9999).

    config WAKE_WORD_ENGINE_DET_TIMEOUT
        int "Detection timeout (ms)"
        default 2000
        range 500 10000
        depends on WAKE_WORD_ENGINE_ENABLE
        help
            Timeout for MultiNet command phrase detection after wake word.
            Duration in milliseconds the engine waits for a complete phrase.

endmenu
```
