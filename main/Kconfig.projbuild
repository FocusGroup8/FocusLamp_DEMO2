## try_pzf/controller/components/websocket_manager/Kconfig.projbuild
```kconfig
menu "WebSocket Manager Configuration"

    config WS_MANAGER_ENABLE
        bool "Enable WebSocket Manager"
        default y
        help
            Enable the WebSocket Manager component. When disabled, all API
            functions return ERR_NOT_SUPPORTED.

    menu "Client Configuration"
        depends on WS_MANAGER_ENABLE

        config WS_MANAGER_CLIENT_ENABLE
            bool "Enable WebSocket Client"
            default y
            help
                Enable WebSocket client functionality.

        config WS_MANAGER_PING_INTERVAL
            int "Ping interval (seconds)"
            default 10
            depends on WS_MANAGER_CLIENT_ENABLE
            help
                WebSocket Ping/Pong keep-alive interval in seconds.

        config WS_MANAGER_RECONNECT_TIMEOUT_MS
            int "Reconnect timeout (milliseconds)"
            default 10000
            depends on WS_MANAGER_CLIENT_ENABLE
            help
                Time to wait before reconnecting after disconnection.
                The actual reconnect uses exponential backoff starting from this value.

        config WS_MANAGER_BUFFER_SIZE
            int "WebSocket buffer size (bytes)"
            default 1024
            depends on WS_MANAGER_CLIENT_ENABLE
            help
                Size of the WebSocket send/receive buffer.
                Also used as the server's pre-allocated receive buffer.
                For text-only usage, 512-1024 is sufficient.
                For binary data or large payloads, increase to 2048-4096.

        config WS_MANAGER_CLIENT_URI
            string "Default client URI"
            default ""
            depends on WS_MANAGER_CLIENT_ENABLE
            help
                Default WebSocket server URI for the client to connect to on startup.
                Leave empty to skip auto-connect. Example: ws://echo.websocket.org

    endmenu

    menu "Server Configuration"
        depends on WS_MANAGER_ENABLE

        config WS_MANAGER_SERVER_ENABLE
            bool "Enable WebSocket Server"
            default y
            select HTTPD_WS_SUPPORT
            help
                Enable WebSocket server functionality based on esp_http_server.

        config WS_MANAGER_SERVER_PORT
            int "Server port"
            default 80
            depends on WS_MANAGER_SERVER_ENABLE
            help
                HTTP/WebSocket server listen port.

        config WS_MANAGER_SERVER_MAX_CONN
            int "Maximum concurrent connections"
            default 4
            depends on WS_MANAGER_SERVER_ENABLE
            help
                Maximum number of simultaneous WebSocket client connections.

        config WS_MANAGER_SERVER_ECHO
            bool "Enable server echo mode"
            default y
            depends on WS_MANAGER_SERVER_ENABLE
            help
                When enabled, the server echoes received messages back to the sender.
                When disabled, received messages are only dispatched via the DATA callback.

    endmenu

    menu "TLS Configuration"
        depends on WS_MANAGER_ENABLE

        config WS_MANAGER_TLS_ENABLE
            bool "Enable TLS support (wss://)"
            default n
            help
                Enable WebSocket over TLS. When enabled, the client can connect
                to wss:// URIs. Server TLS support requires certificate configuration.

    endmenu

endmenu
```

## try_pzf/head/components/connection_manager/Kconfig
```kconfig
menu "Connection Manager"

    config CONNECTION_MANAGER_ENABLE
        bool "Enable Connection Manager"
        default y
        help
            Enable the Connection Manager component for unified WiFi and
            WebSocket health monitoring and automatic recovery.

    if CONNECTION_MANAGER_ENABLE

        config CONNECTION_MANAGER_WIFI_INIT_TIMEOUT_MS
            int "WiFi init timeout (ms)"
            default 30000
            help
                Maximum time to wait for WiFi initialization.

        config CONNECTION_MANAGER_WIFI_RECONNECT_MAX_DELAY_MS
            int "WiFi reconnect max delay (ms)"
            default 60000
            help
                Maximum delay for WiFi exponential backoff reconnection.

        config CONNECTION_MANAGER_WS_RECONNECT_MAX_DELAY_MS
            int "WebSocket reconnect max delay (ms)"
            default 60000
            help
                Maximum delay for WebSocket exponential backoff reconnection.

        config CONNECTION_MANAGER_MONITOR_INTERVAL_MS
            int "Health monitor interval (ms)"
            default 5000
            help
                Interval for periodic connection health checks.

    endif

endmenu
```

## try_pzf/head/components/message_queue/Kconfig
```kconfig
menu "Message Queue"

    config MESSAGE_QUEUE_ENABLE
        bool "Enable Message Queue"
        default y
        help
            Enable the Message Queue for reliable WebSocket message
            delivery with automatic retry on send failure.

    if MESSAGE_QUEUE_ENABLE

        config MESSAGE_QUEUE_MAX_PENDING
            int "Maximum pending messages"
            default 16
            help
                Maximum number of messages that can be queued for retry.

        config MESSAGE_QUEUE_MAX_RETRIES
            int "Maximum send retries"
            default 3
            help
                Maximum number of send attempts per queued message.

    endif

endmenu
```

## try_pzf/head/components/wifi_manager/Kconfig.projbuild
```kconfig
menu "WiFi Manager Configuration"

    config WIFI_MANAGER_ENABLE
        bool "Enable WiFi Manager"
        default y
        help
            Enable the WiFi Manager component. When disabled, all API
            functions return ERR_NOT_SUPPORTED.

    config WIFI_MANAGER_SSID
        string "WiFi SSID"
        default "myssid"
        depends on WIFI_MANAGER_ENABLE
        help
            SSID (network name) of the access point to connect to.

    config WIFI_MANAGER_PASSWORD
        string "WiFi Password"
        default "mypassword"
        depends on WIFI_MANAGER_ENABLE
        help
            WiFi password (WPA2 or WPA3) for the access point.

    config WIFI_MANAGER_MAX_RETRY
        int "Maximum retry count"
        default 5
        depends on WIFI_MANAGER_ENABLE
        help
            Maximum number of retries to connect to the AP before giving up.

    config WIFI_MANAGER_AUTO_RECONNECT
        bool "Enable auto-reconnect"
        default y
        depends on WIFI_MANAGER_ENABLE
        help
            Automatically reconnect to AP when disconnected.

    config WIFI_MANAGER_USE_STATIC_IP
        bool "Use static IP (avoid DHCP drift)"
        default n
        depends on WIFI_MANAGER_ENABLE
        help
            Use a static IP instead of DHCP. Prevents the DHCP server from
            re-assigning a different address after reconnect, which would
            break cross-board HTTP/WS links that are configured by IP.

    config WIFI_MANAGER_STATIC_IP
        string "Static IP address"
        default "10.132.136.143"
        depends on WIFI_MANAGER_USE_STATIC_IP
        help
            Fixed IP address for this board (lamp head board).

    config WIFI_MANAGER_STATIC_GATEWAY
        string "Static gateway"
        default "10.132.136.105"
        depends on WIFI_MANAGER_USE_STATIC_IP
        help
            Gateway of the RT3 hotspot network.

    config WIFI_MANAGER_STATIC_NETMASK
        string "Static netmask"
        default "255.255.255.0"
        depends on WIFI_MANAGER_USE_STATIC_IP
        help
            Subnet mask.

    config WIFI_MANAGER_STATIC_DNS
        string "Static DNS server"
        default "10.132.136.105"
        depends on WIFI_MANAGER_USE_STATIC_IP
        help
            DNS server used with the static IP. Required because the DHCP
            client is stopped, so the DHCP-provided DNS is no longer available.

endmenu
```
